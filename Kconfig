## Kconfig
```kconfig
menuconfig AZ1UBALL
  bool "Palette-System AZ1UBALL Trackball Support"
  select ZMK_POINTING
  select I2C
  help
    Enable driver for Palette-System AZ1UBALL Trackball.

if AZ1UBALL
  config AZ1UBALL_AUTOMOUSE_TIMEOUT_MS
    int "Amount of milliseconds the mouse layer will be active after using the trackball"
    default 400

  module = AZ1UBALL
  module-str = AZ1UBALL
  source "${ZEPHYR_BASE}/subsys/logging/Kconfig.template.log_config"

endif #AZ1UBALL
```

## dts/bindings/palette,az1uball.yml
```yaml
description: AZ1UBALL trackball sensor

compatible: "palette,az1uball"

include: i2c-device.yaml

properties:
  reg:
    required: true
    description: I2C address of the trackball

  automouse-layer:
    type: int
    default: -1

  default-mode:
    type: string
    default: "mouse"
    enum:
      - "mouse"
      - "scroll"
    description: |
      デフォルトのトラックボールモード
      - "mouse": 通常のマウスモード
      - "scroll": スクロールモード

  sensitivity:
    type: string
    default: "1x"
    description: |
      トラックボールの感度設定（例: "2x", "0.5x"）
      デフォルトは "1x"n
      
  flip_x:
    type: boolean
    description: "Flip the X-axis direction"

  flip_y:
    type: boolean
    description: "Flip the Y-axis direction"
```
